## components/spotify_client/Kconfig
```kconfig
menu "Spotify Client Configuration"

    config DISCORD_TOKEN
        string "Discord Token"
        default ""
        help
        	The token associated to your Discord account. TODO: add steps to obtain it.
        	WARNING: this is a full-privilege Discord user token, used against
        	an undocumented internal Discord endpoint to obtain a Spotify
        	access token. This is a deliberate trade-off (see
        	components/spotify_client/ANALYSIS.md, item 1.8): it is the only
        	practical way found so far to also get access to Spotify's
        	private real-time WebSocket. A leaked token exposes your full
        	Discord account, not just Spotify.
        	
    config SPOTIFY_UID
        string "Spotify UID"
        default ""
        help
        	The user ID of your Spotify account. TODO: add steps to obtain it.

endmenu
```

## sdkconfig.defaults
```kconfig
# Target board: JC3248W535 (ESP32-S3, 16MB flash, octal PSRAM)
CONFIG_IDF_TARGET="esp32s3"
CONFIG_ESPTOOLPY_FLASHSIZE_16MB=y
CONFIG_ESPTOOLPY_FLASHSIZE="16MB"

CONFIG_SPIRAM=y
CONFIG_SPIRAM_MODE_OCT=y
CONFIG_SPIRAM_TYPE_AUTO=y
CONFIG_SPIRAM_SPEED=40
CONFIG_SPIRAM_USE_MALLOC=y

# mbedTLS must use PSRAM for its large TLS buffers (IN/OUT content len),
# otherwise TLS handshakes fail with PSA_ERROR_INSUFFICIENT_MEMORY once
# internal RAM gets contended by WiFi + display buffers.
CONFIG_MBEDTLS_EXTERNAL_MEM_ALLOC=y
```
